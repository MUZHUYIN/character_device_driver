/dts-v1/;
/plugin/;

/ {
	compatible = "raspberrypi,5-model-b", "brcm,bcm2712";
};

&spi0 {
	status = "okay";
	#address-cells = <1>;
	#size-cells = <0>;

	ili9341: ili9341@0 {
		compatible = "codex,rpi5-ili9341";
		reg = <0>;
		spi-max-frequency = <16000000>;
		dc-gpios = <&rp1_gpio 24 0>;
		reset-gpios = <&rp1_gpio 25 1>;

		rotation = <0>;
		bgr;
		status = "okay";
	};
};

&spidev0 {
	status = "disabled";
};
